#include <behaviors.dtsi>
#include <dt-bindings/zmk/keys.h>

#ifdef CONFIG_WIRELESS
    #include <dt-bindings/zmk/bt.h>
    #include <dt-bindings/zmk/outputs.h>
       #define _BT_SEL_KEYS_ \
         &bt BT_SEL 3 &bt BT_SEL 2 &bt BT_SEL 1 &bt BT_SEL 0 &bt BT_SEL 4
       #define _BT_CONF_KEYS_ \
         &bt BT_CLR_ALL &bt BT_CLR &bt BT_PRV &bt BT_NXT  &out OUT_TOG
#else
       #define _BT_SEL_KEYS_ &trans &trans &trans &trans &trans
       #define _BT_CONF_KEYS_ &trans &trans &trans &trans &trans
#endif

#ifdef CONFIG_MOUSE_EMULATION
    #define ZMK_POINTING_DEFAULT_MOVE_VAL 1500  // default: 600
    // this not used when CONFIG_SMOOTH_SCROLLING enabled
    // #define ZMK_POINTING_DEFAULT_SCRL_VAL 20    // default: 10

    #include <dt-bindings/zmk/pointing.h>
        #define MLCLK &mkp LCLK // Left Click
        #define MRCLK &mkp RCLK // Right Click
        #define MDCLK &mkp MCLK // Middle Click
        #define MBCK &mkp MB4 // Backward
        #define MFWD &mkp MB5 // Forward

        #define MSDN &mmv MOVE_DOWN // Move Mouse Down
        #define MSUP &mmv MOVE_UP // Move Mouse Up
        #define MSRI &mmv MOVE_RIGHT // Move Mouse Right
        #define MSLE &mmv MOVE_LEFT // Move Mouse Left

        #ifdef CONFIG_SMOOTH_SCROLLING
            // Read more on note section of
            // https://zmk.dev/docs/keymaps/behaviors/mouse-emulation#examples-2
            #define MSCDN &msc MOVE_DOWN // Scroll Down
            #define MSCUP &msc MOVE_UP // Scroll Up
            #define MSCRI &msc MOVE_RIGHT // Scroll Right
            #define MSCLE &msc MOVE_LEFT // Scroll Left
        #else
            #define MSCDN &msc SCRL_DOWN // Scroll Down
            #define MSCUP &msc SCRL_UP // Scroll Up
            #define MSCRI &msc SCRL_RIGHT // Scroll Right
            #define MSCLE &msc SCRL_LEFT // Scroll Left
        #endif
#else
        #define MLCLK &trans
        #define MRCLK &trans
        #define MDCLK &trans
        #define MBCK &trans
        #define MFWD &trans
        #define MSDN &trans
        #define MSUP &trans
        #define MSRI &trans
        #define MSLE &trans
        #define MSCDN &trans
        #define MSCUP &trans
        #define MSCRI &trans
        #define MSCLE &trans
#endif

#include "zmk-helpers/helper.h"

// -----------------------------------------------------------------------------------------
// Global settings
// -----------------------------------------------------------------------------------------

// HOST_OS variables zmk-helper
// Windows is undef
#define LINUX 1
#define MACOS 2

#define DHM 0 // Colemak-DH
#define QWE 1 // Qwerty
#define STE 2 // Stenography
#define NUM 3
#define SYM 4
#define NAV 5
#define MED 6
#define MSE 7

#define XXX &none
#define ___ &trans

#define CANCEL &kp K_CANCEL

#define QUICK_TAP_MS 175

#define SIMPLE_MORPH(NAME, MOD, BINDING1, BINDING2)         \
    ZMK_MOD_MORPH(NAME, mods = <(MOD_L##MOD|MOD_R##MOD)>;   \
                  bindings = <BINDING1>, <BINDING2>;)

&lt {
  tapping-term-ms = <200>;
  quick-tap-ms = <QUICK_TAP_MS>;
  flavor = "balanced";
};

&sk {
  release-after-ms = <900>;
  quick-release;
};

&sl {
  ignore-modifiers; // Allow sticky mods to chord across sticky layers
};

&caps_word {
  continue-list = <UNDERSCORE MINUS BACKSPACE DELETE>;
};

&key_repeat {
  usage-pages = <HID_USAGE_KEY HID_USAGE_CONSUMER>;
};

// -----------------------------------------------------------------------------------------
// Homerow mods
// -----------------------------------------------------------------------------------------

// https://github.com/urob/zmk-config/tree/main#timeless-homerow-mods
#define KEYS_L LT0 LT1 LT2 LT3 LT4 LM0 LM1 LM2 LM3 LM4 LB0 LB1 LB2 LB3 LB4  // left hand
#define KEYS_R RT0 RT1 RT2 RT3 RT4 RM0 RM1 RM2 RM3 RM4 RB0 RB1 RB2 RB3 RB4  // right hand
#define THUMBS LH1 LH0 RH0 RH1                                              // thumbs

#define MAKE_HRM(NAME, TRIGGER_POS)                                         \
    ZMK_HOLD_TAP(NAME,  bindings = <&kp>, <&kp>; flavor = "balanced";       \
                 tapping-term-ms = <280>; quick-tap-ms = <QUICK_TAP_MS>;    \
                 require-prior-idle-ms = <150>; hold-trigger-on-release;    \
                 hold-trigger-key-positions = <TRIGGER_POS>;)

MAKE_HRM(hml, KEYS_R THUMBS)
MAKE_HRM(hmr, KEYS_L THUMBS)

// MacOS Specific HomeRow
#if HOST_OS == MACOS
       #define HML_0 LGUI
       #define HML_1 LALT
       #define HML_2 LSHFT
       #define HML_3 LCTRL

       #define HMR_0 RGUI
       #define HMR_1 LALT
       #define HMR_2 RSHFT
       #define HMR_3 RCTRL
#else
       #define HML_0 LCTRL
       #define HML_1 LALT
       #define HML_2 LSHFT
       #define HML_3 LGUI

       #define HMR_0 RCTRL
       #define HMR_1 LALT
       #define HMR_2 RSHFT
       #define HMR_3 RGUI
#endif

#include "macros.dtsi"
#include "combos.dtsi"
#include "tapdance.dtsi"

// -----------------------------------------------------------------------------------------
// Magic-Shift & Smart-Num
// -----------------------------------------------------------------------------------------

// Tap: repeat after alpha, else sticky-shift |
// Shift + tap/double-tap : caps-word | Hold: shift
#define MAGIC_SHIFT &magic_shift LSHFT 0
ZMK_HOLD_TAP(magic_shift, bindings = <&kp>, <&magic_shift_tap>;
             flavor = "balanced"; tapping-term-ms = <200>;
             quick-tap-ms = <QUICK_TAP_MS>;)
ZMK_MOD_MORPH(magic_shift_tap, bindings = <&shift_repeat>, <&caps_word>;
              mods = <(MOD_LSFT)>;)
ZMK_ADAPTIVE_KEY(
      shift_repeat, bindings = <&sk LSHFT>;
      repeat {
        trigger-keys = <A B C D E F G H I J K L M N O P Q R S T U V W X Y Z
                        LPAR RPAR LBRC RBRC LBKT RBKT BSLH FSLH
                        EQUAL PLUS MINUS PIPE UNDER SEMI COLON HASH>;
        bindings = <&key_repeat>;
        max-prior-idle-ms = <1200>;
};)

// Tap: sticky num-layer | Double-tap: num-word | Hold: sym-layer
#define SMART_NUM &smart_num SYM 0
ZMK_HOLD_TAP(smart_num, bindings = <&mo>, <&num_dance>; flavor = "balanced";
             tapping-term-ms = <200>; quick-tap-ms = <QUICK_TAP_MS>;)
ZMK_TAP_DANCE(num_dance, bindings = <&num_word NUM>, <&sl NUM>;
              tapping-term-ms = <200>;)
ZMK_AUTO_LAYER(num_word,
    continue-list = <BSPC DEL DOT COMMA PLUS MINUS STAR FSLH EQUAL LPAR RPAR LBKT RBKT LBRC LBRC DOT COMMA PIPE UP DOWN RIGHT LEFT>;
    ignore-modifiers;
    ignore-numbers;
)

// -----------------------------------------------------------------------------------------
// Swapper
// -----------------------------------------------------------------------------------------

// Cmd+Tab swapper, requires tri-state module.
#if HOST_OS == MACOS
    ZMK_TRI_STATE(swapper, bindings = <&kt LGUI>, <&kp TAB>, <&kt LGUI>;
                  // For Q SHIFT-TAB LEFT DOWN UP RIGHT and LCLK for mouse
                  ignored-key-positions = <LT4 LT3 RM0 RM1 RM2 RM3 RH1>;)
    #define SWAPQUIT &kp Q
#else
// Alt+Tab swapper
    ZMK_TRI_STATE(swapper, bindings = <&kt LALT>, <&kp TAB>, <&kt LALT>;
                  ignored-key-positions = <LT2 LT3 RM1 RM2 RM3>;)
    #if HOST_OS == LINUX
        #define SWAPQUIT &kp Q
    #else // Windows
        #define SWAPQUIT &kp DEL
    #endif
#endif

// -----------------------------------------------------------------------------------------
// Smart-mouse
// -----------------------------------------------------------------------------------------

//ZMK_TRI_STATE(smart_mouse, bindings = <&tog MSE>, <&none>, <&tog MSE>;
//             ignored-key-positions =
//               // Make sure to add combo invocation into this,
//               // In this case it is LT1 & LT2
//               <LT1 LT2 LT3 LT4 LM0 LM1 LM2 LM3 LM4 LB0 LB1 LB2 LB3 LB4 LH0 LH1 RT0 RT1 RT2 RT3 RM0 RM1 RM2 RM3 RM4 RB0 RB1 RB2 RB3 RH0 RH1>;
//              ignored-layers = <MSE NAV MED>;)

// -----------------------------------------------------------------------------------------
// Nav Morph
// -----------------------------------------------------------------------------------------

ZMK_AUTO_LAYER(nav_word,
    continue-list = <LEFT DOWN UP RIGHT PG_DN PG_UP>;
    ignore-modifiers;
)

// Tap: spc | Shift + tap: dot -> spc -> sticky shift (sentence) | Hold: nav-layer
ZMK_HOLD_TAP(lt_spc, bindings = <&mo>, <&spc_morph>; flavor = "balanced";
             tapping-term-ms = <200>; quick-tap-ms = <QUICK_TAP_MS>;)
SIMPLE_MORPH(spc_morph, SFT, &kp SPC, &dot_spc)
ZMK_MACRO(dot_spc, bindings = <&kp DOT &kp SPACE &sk LSHFT>; wait-ms = <0>;
          tap-ms = <5>;)

// -----------------------------------------------------------------------------------------
// Nav Commands
// -----------------------------------------------------------------------------------------

// Trigger tap-action on all interrupts.
#define MT_CORE                                                                \
  flavor = "tap-preferred";                                                    \
  tapping-term-ms = <220>;                                                     \
  quick-tap-ms = <220>;                                                        \
  hold-trigger-key-positions = <0>;

&mt { MT_CORE };

ZMK_HOLD_TAP(ht_home, bindings = <&masked_home>, <&kp>; MT_CORE)
ZMK_HOLD_TAP(ht_end, bindings = <&masked_end>, <&kp>; MT_CORE)

#define MASK_MODS(NAME, MODS, BINDING)                                         \
    ZMK_MOD_MORPH(NAME, bindings = <BINDING>, <BINDING>; mods = <MODS>;)

#define NAV_LEFT &ht_home 0 LEFT
#define NAV_RIGHT &ht_end 0 RIGHT

#if HOST_OS == MACOS
    // Mask CMD on left/right hold to avoid accidental jumps to start/end of doc.
    MASK_MODS(masked_home, (MOD_LGUI), &kp LG(LEFT))
    MASK_MODS(masked_end,  (MOD_LGUI), &kp LG(RIGHT))

    #define NAV_PG_UP &mt LG(UP) PG_UP
    #define NAV_PG_DN &mt LG(DOWN) PG_DN
    #define NAV_BSPC &mt LA(BSPC) BSPC
    #define NAV_DEL &mt LA(DEL) DEL
#else
    // Mask CTRL on left/right hold to avoid accidental jumps to start/end of doc.
    MASK_MODS(masked_home, (MOD_LCTL), &kp HOME)
    MASK_MODS(masked_end,  (MOD_LCTL), &kp END)

    #define NAV_PG_UP &mt LC(HOME) PG_UP
    #define NAV_PG_DN &mt LC(END) PG_DN
    #define NAV_BSPC &mt LC(BSPC) BSPC
    #define NAV_DEL &mt LC(DEL) DEL
#endif

// -----------------------------------------------------------------------------------------
// Editing Commands
// -----------------------------------------------------------------------------------------

#if HOST_OS == MACOS
    #define RZ_COPY &kp LG(C)
    #define CUTMOVE &kp LG(LA(V))
    #define PASTE &kp LG(V)
    #define RZ_UNDO &kp LG(Z)
    #define REDO &kp LG(LS(Z))
#else
    #define RZ_COPY &kp LC(C)
    #define CUTMOVE &kp LC(X)
    #define PASTE &kp LC(V)
    #define RZ_UNDO &kp LC(Z)
    #define REDO &kp LC(Y)
#endif

// -----------------------------------------------------------------------------------------
// Stenography Workarounds
// -----------------------------------------------------------------------------------------

// For explanation check the "Ste" layer below..
#define ST_HASH &kp N9
#define _ST_HASH_TOP_LEFT_ \
     ST_HASH ST_HASH ST_HASH ST_HASH ST_HASH
#define _ST_HASH_TOP_RIGHT_ \
     ST_HASH ST_HASH ST_HASH ST_HASH ST_HASH
#define ST_STAR &kp N0
#define ST_R_T &kp N1
#define ST_R_P &kp N2
#define ST_R_S &kp N3
#define ST_R_R &kp N4

// -----------------------------------------------------------------------------------------
// Keymap
// -----------------------------------------------------------------------------------------

#ifndef ZMK_BASE_LAYER
    #define ZMK_BASE_LAYER(name, LT, RT, LM, RM, LB, RB, LH, RH)  \
         ZMK_LAYER(name, LT RT LM RM LB RB LH RH)
#endif

ZMK_BASE_LAYER(Dhm,
//╭─────────────┬─────────────┬─────────────┬─────────────┬─────────────╮ ╭─────────────┬─────────────┬─────────────┬─────────────┬─────────────╮
	   &kp Q         &kp W         &kp F         &kp P         &kp B    ,      &kp J         &kp L         &kp U         &kp Y       &kp SEMI   ,
//├─────────────┼─────────────┼─────────────┼─────────────┼─────────────┤ ├─────────────┼─────────────┼─────────────┼─────────────┼─────────────┤
	&hml HML_3 A  &hml HML_2 R  &hml HML_1 S  &hml HML_0 T     &kp G    ,      &kp M      &hmr HMR_0 N  &hmr HMR_1 E  &hmr HMR_2 I &hmr HMR_3 O ,
//├─────────────┼─────────────┼─────────────┼─────────────┼─────────────┤ ├─────────────┼─────────────┼─────────────┼─────────────┼─────────────┤
	   &kp Z         &kp X         &kp C         &kp D         &kp V    ,      &kp K        &kp H        &kp COMMA      &kp DOT      &kp FSLH   ,
//╰─────────────┼─────────────┴─────────────┼─────────────┼─────────────┤ ├─────────────┼─────────────┼─────────────┴───────────────────────────╯
	                                         &lt_spc NAV 0  &lt MED RET ,    SMART_NUM    MAGIC_SHIFT
//                                          ╰─────────────┴─────────────╯ ╰─────────────┴─────────────╯
// conditional layers                                              ╰-------(nul)-------╯
//                                                   ╰---------------------(nul)---------------------╯
//                                                                 ╰------ (nul)---------------------╯
//                                                   ╰---------------------(nul)-------╯
)

ZMK_BASE_LAYER(Qwe,
//╭─────────────┬─────────────┬─────────────┬─────────────┬─────────────╮ ╭─────────────┬─────────────┬─────────────┬─────────────┬─────────────╮
	&kp Q           &kp W        &kp E          &kp R          &kp T    ,      &kp Y         &kp U         &kp I         &kp O         &kp P    ,
//├─────────────┼─────────────┼─────────────┼─────────────┼─────────────┤ ├─────────────┼─────────────┼─────────────┼─────────────┼─────────────┤
    &hml HML_3 A  &hml HML_2 S  &hml HML_1 D  &hml HML_0 F     &kp G    ,      &kp H      &hmr HMR_0 J  &hmr HMR_1 K &hmr HMR_2 L &hmr HMR_3 SEMI,
//├─────────────┼─────────────┼─────────────┼─────────────┼─────────────┤ ├─────────────┼─────────────┼─────────────┼─────────────┼─────────────┤
	&kp Z           &kp X        &kp C          &kp V          &kp B    ,      &kp N         &kp M       &kp COMMA      &kp DOT      &kp FSLH   ,
//╰─────────────┼─────────────┴─────────────┼─────────────┼─────────────┤ ├─────────────┼─────────────┼─────────────┴───────────────────────────╯
	                                         &lt_spc NAV 0  &lt MED RET ,    SMART_NUM    MAGIC_SHIFT
//                                          ╰─────────────┴─────────────╯ ╰─────────────┴─────────────╯
// conditional layer also applies here
)

ZMK_BASE_LAYER(Ste,
// Make sure that you have this customized in `~/.config/plover/plover.cfg` to prevent plover remapping QWERTY
// [System: Lapwing] # or any other system, eg. "English Stenotype"
// keymap[keyboard] = [["#", ["9"]], ["S-", ["s"]], ["T-", ["t"]], ["K-",
// ["k"]], ["P-", ["p"]], ["W-", ["w"]], ["H-", ["h"]], ["R-", ["r"]], ["A-",
// ["a"]], ["O-", ["o"]], ["*", ["0"]], ["-E", ["e"]], ["-U", ["u"]], ["-F",
// ["f"]], ["-R", ["4"]], ["-P", ["2"]], ["-B", ["b"]], ["-L", ["l"]], ["-G",
// ["g"]], ["-T", ["1"]], ["-S", ["3"]], ["-D", ["d"]], ["-Z", ["z"]],
// ["arpeggiate", ["space"]], ["no-op", ["\\", "]", "x", ",", ".", "/"]]]
//
// Layer simulate stenography, further customized in plover machine setting for the duplicate keys
// In this case the duplicate keys are -T, -P, -S, and -R that are being represented by number 1-4
// Also since plover doesn't have HASH and STAR, I decided to use number 9 and 0 respectively
//╭─────────────┬─────────────┬─────────────┬─────────────┬─────────────╮ ╭─────────────┬─────────────┬─────────────┬─────────────┬─────────────╮
//|     #       |      #      |      #      |      #      |      #      | |      #      |      #      |      #      |      #      |      #      |
                            _ST_HASH_TOP_LEFT_                          ,                           _ST_HASH_TOP_RIGHT_                         ,
//├─────────────┼─────────────┼─────────────┼─────────────┼─────────────┤ ├─────────────┼─────────────┼─────────────┼─────────────┼─────────────┤
//|     #       |     T-      |     P-      |     H-      |      *      | |     -F      |     -P      |     -L      |     -T      |     -D      |
      ST_HASH       &kp T         &kp P          &kp H        ST_STAR   ,      &kp F        ST_R_P        &kp L         ST_R_T        &kp D     ,
//├─────────────┼─────────────┼─────────────┼─────────────┼─────────────┤ ├─────────────┼─────────────┼─────────────┼─────────────┼─────────────┤
//|     S-      |     K-      |     W-      |     R-      |      *      | |     -R      |     -B      |     -G      |     -S      |     -Z      |
	  &kp S         &kp K         &kp W          &kp R        ST_STAR   ,     ST_R_R         &kp B        &kp G         ST_R_S        &kp Z     ,
//╰─────────────┼─────────────┴─────────────┼─────────────┼─────────────┤ ├─────────────┼─────────────┼─────────────┴───────────────────────────╯
//                                          |     A-      |     O-      | |     -E      |     -U      |
	                                            &kp A         &kp O     ,      &kp E         &kp U
//                                          ╰─────────────┴─────────────╯ ╰─────────────┴─────────────╯
)


ZMK_BASE_LAYER(Num,
//╭─────────────┬─────────────┬─────────────┬─────────────┬─────────────╮ ╭─────────────┬─────────────┬─────────────┬─────────────┬─────────────╮
//|     [       |             |             |             |      ]      | |             |             |             |             |             |
	&kp LBKT        &kp N7       &kp N8         &kp N9       &kp RBKT   ,    &tog QWE    &bt BT_SEL 0  &bt BT_SEL 1  &bt BT_SEL 2       ___     ,
//├─────────────┼─────────────┼─────────────┼─────────────┼─────────────┤ ├─────────────┼─────────────┼─────────────┼─────────────┼─────────────┤
//|     '       |             |             |             |      =      | |      -      |             |             |             |             |
  &hml HML_3 SQT &hml HML_2 N4 &hml HML_1 N5 &hml HML_0 N6   &kp EQUAL  ,    &kp MINUS     &kp HMR_0     &kp HMR_1     &kp HMR_2     &kp HMR_3  ,
//├─────────────┼─────────────┼─────────────┼─────────────┼─────────────┤ ├─────────────┼─────────────┼─────────────┼─────────────┼─────────────┤
//|     `       |             |             |             |             | |      \      |             |             |             |             |
	&kp GRAVE       &kp N1       &kp N2         &kp N3        &kp N0    ,    &kp BSLH      NAV_BSPC       NAV_DEL       &td_dot         ___     ,
//╰─────────────┼─────────────┴─────────────┼─────────────┼─────────────┤ ├─────────────┼─────────────┼─────────────┴───────────────────────────╯
	                                         &lt_spc NAV 0  &lt MED RET ,    SMART_NUM    MAGIC_SHIFT
//                                          ╰─────────────┴─────────────╯ ╰─────────────┴─────────────╯
)

ZMK_BASE_LAYER(Sym,
//╭─────────────┬─────────────┬─────────────┬─────────────┬─────────────╮ ╭─────────────┬─────────────┬─────────────┬─────────────┬─────────────╮
//|     {       |      &      |      *      |      (      |      }      | |             |             |             |             |      :      |
	  &kp LBRC      &kp AMPS     &kp STAR       &kp LPAR      &kp RBRC  ,    &kp GLOBE        ___           ___     &kp PAUSE_BREAK  &kp COLON  ,
//├─────────────┼─────────────┼─────────────┼─────────────┼─────────────┤ ├─────────────┼─────────────┼─────────────┼─────────────┼─────────────┤
//|     "       |      $      |      %      |      ^      |      +      | |      _      |             |             |             |             |
&hml HML_3 DQT &hml HML_2 DLLR &hml HML_1 PRCNT &hml HML_0 CARET &kp PLUS ,  &kp UNDER    &kp HMR_0      &kp HMR_1     &kp HMR_2     &kp HMR_3  ,
//├─────────────┼─────────────┼─────────────┼─────────────┼─────────────┤ ├─────────────┼─────────────┼─────────────┼─────────────┼─────────────┤
//|     ~       |      !      |      @      |      #      |      )      | |      |      |             |             |             |      ?      |
	&kp TILDE      &kp EXCL     &kp AT_SIGN    &kp HASH       &kp RPAR  ,     &kp PIPE     NAV_BSPC       NAV_DEL       &td_dot      &kp QMARK  ,
//╰─────────────┼─────────────┴─────────────┼─────────────┼─────────────┤ ├─────────────┼─────────────┼─────────────┴───────────────────────────╯
	                                         &lt_spc NAV 0  &lt MED RET ,       ___       MAGIC_SHIFT
//                                          ╰─────────────┴─────────────╯ ╰─────────────┴─────────────╯
)

ZMK_BASE_LAYER(Nav,
//╭─────────────┬─────────────┬─────────────┬─────────────┬─────────────╮ ╭─────────────┬─────────────┬─────────────┬─────────────┬─────────────╮
  	 SWAPQUIT     &kp LS(TAB)    &swapper        PASTE          ___     ,       ___        NAV_PG_DN     NAV_PG_UP      RZ_COPY      &kp SYSREQ ,
//├─────────────┼─────────────┼─────────────┼─────────────┼─────────────┤ ├─────────────┼─────────────┼─────────────┼─────────────┼─────────────┤
  	 &sk HML_3     &sk HML_2     &sk HML_1     &sk HML_0     &kp SLCK   ,     NAV_LEFT      &kp DOWN      &kp UP       NAV_RIGHT     &kp CAPS   ,
//├─────────────┼─────────────┼─────────────┼─────────────┼─────────────┤ ├─────────────┼─────────────┼─────────────┼─────────────┼─────────────┤
  	 &kp PSCRN      RZ_UNDO        REDO         CUTMOVE         ___     ,     &kp TAB       NAV_BSPC      NAV_DEL     &key_repeat     &kp INS   ,
//╰─────────────┼─────────────┴─────────────┼─────────────┼─────────────┤ ├─────────────┼─────────────┼─────────────┴───────────────────────────╯
                                                  ___           ___     ,    &kp K_APP    MAGIC_SHIFT
//                                          ╰─────────────┴─────────────╯ ╰─────────────┴─────────────╯
)

ZMK_BASE_LAYER(Med,
//╭─────────────┬─────────────┬─────────────┬─────────────┬─────────────╮ ╭─────────────┬─────────────┬─────────────┬─────────────┬─────────────╮
	&bootloader     &kp F7        &kp F8        &kp F9       &kp F12    ,    &kp K_PWR    &kp K_LOCK    &kp C_STOP        ___       &bootloader ,
//├─────────────┼─────────────┼─────────────┼─────────────┼─────────────┤ ├─────────────┼─────────────┼─────────────┼─────────────┼─────────────┤
    &hml HML_3 0 &hml HML_2 F4 &hml HML_1 F5 &hml HML_0 F6   &kp F11    ,    &kp C_PREV  &kp C_VOL_DN   &kp C_VOL_UP   &kp C_NEXT &studio_unlock,
//├─────────────┼─────────────┼─────────────┼─────────────┼─────────────┤ ├─────────────┼─────────────┼─────────────┼─────────────┼─────────────┤
	&sys_reset      &kp F1        &kp F2        &kp F3       &kp F10    ,    &kp C_PIP   &kp C_BRI_DN   &kp C_BRI_UP      ___        &sys_reset ,
//╰─────────────┼─────────────┴─────────────┼─────────────┼─────────────┤ ├─────────────┼─────────────┼─────────────┴───────────────────────────╯
	                                              ___           ___     ,    &kp C_MUTE   &kp C_PP
//                                          ╰─────────────┴─────────────╯ ╰─────────────┴─────────────╯
)

ZMK_BASE_LAYER(Mse,
//╭─────────────┬─────────────┬─────────────┬─────────────┬─────────────╮ ╭─────────────┬─────────────┬─────────────┬─────────────┬─────────────╮
  	                           _BT_SEL_KEYS_                            ,       MBCK       NAV_PG_DN     NAV_PG_UP        MFWD          ___     ,
//├─────────────┼─────────────┼─────────────┼─────────────┼─────────────┤ ├─────────────┼─────────────┼─────────────┼─────────────┼─────────────┤
     &sk HML_3     &sk HML_2     &sk HML_1     &sk HML_0        ___     ,       MSLE          MSDN          MSUP          MSRI         MDCLK    ,
//├─────────────┼─────────────┼─────────────┼─────────────┼─────────────┤ ├─────────────┼─────────────┼─────────────┼─────────────┼─────────────┤
                               _BT_CONF_KEYS_                           ,      MSCLE         MSCDN         MSCUP         MSCRI          ___     ,
//╰─────────────┼─────────────┴─────────────┼─────────────┼─────────────┤ ├─────────────┼─────────────┼─────────────┴───────────────────────────╯
                                             &lt_spc NAV 0  &lt MED RET ,      MRCLK         MLCLK
//                                          ╰─────────────┴─────────────╯ ╰─────────────┴─────────────╯
)
