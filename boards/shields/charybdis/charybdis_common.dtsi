#include <dt-bindings/zmk/matrix_transform.h>
#include "charybdis_layout.dtsi"

/ {
	chosen {
		zmk,physical-layout = &physical_layout0;
	};

	kscan0: kscan {
		compatible = "zmk,kscan-gpio-matrix";
		// label = "KSCAN";

		diode-direction = "row2col";
		wakeup-source;
	};

	// TODO: RGB node(s)
};
