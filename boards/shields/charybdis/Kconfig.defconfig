## boards/shields/charybdis/Kconfig.defconfig
```kconfig
if SHIELD_CHARYBDIS_LEFT || SHIELD_CHARYBDIS_ADAPTERV2_LEFT

config ZMK_KEYBOARD_NAME
    default "Charybdis"

config ZMK_SPLIT_BLE_ROLE_CENTRAL
    default y

endif

if SHIELD_CHARYBDIS_RIGHT

config ZMK_KEYBOARD_NAME
    default "Charybdis Right"

endif

if SHIELD_CHARYBDIS

config ZMK_SPLIT
    default y

endif
```

## boards/shields/charybdis/Kconfig.shield
```kconfig
config SHIELD_CHARYBDIS
    bool

config SHIELD_CHARYBDIS_LEFT
    def_bool $(shields_list_contains,charybdis_left)
        select SHIELD_CHARYBDIS

config SHIELD_CHARYBDIS_RIGHT
    def_bool $(shields_list_contains,charybdis_right)
        select SHIELD_CHARYBDIS

config SHIELD_CHARYBDIS_ADAPTERV2_LEFT
	def_bool $(shields_list_contains,charybdis_adapterv2_left)
	select SHIELD_CHARYBDIS

config SHIELD_CHARYBDIS_ADAPTERV2_RIGHT
	def_bool $(shields_list_contains,charybdis_adapterv2_right)
	select SHIELD_CHARYBDIS
```
